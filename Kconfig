## defconfigs/iso_interstp_defconfig
```kconfig
# hub SS7 interstp (noeud WAN)
CONFIG_TARGET_ISO_LIVE=y
CONFIG_ISO_IMAGE_INTERSTP=y
```

## defconfigs/iso_operator_defconfig
```kconfig
# ISO operator, noeud 1
CONFIG_TARGET_ISO_LIVE=y
CONFIG_ISO_IMAGE_OPERATOR=y
CONFIG_ISO_NODE=1
```

## kconfig/Kconfig.advanced
```kconfig
# kconfig/Kconfig.advanced - options avancees

menu "Options avancees"
	depends on BUILDS_IMAGE

choice
	prompt "Moteur de build"
	default BACKEND_BAKE

config BACKEND_BAKE
	bool "docker buildx bake : une session BuildKit, images en parallele"
config BACKEND_COMPOSE
	bool "docker compose build : une image apres l'autre"
config BACKEND_DOCKER
	bool "docker build : sans compose ni bake"

endchoice

config BACKEND
	string
	default "compose" if BACKEND_COMPOSE
	default "docker" if BACKEND_DOCKER
	default "bake"

choice
	prompt "Sortie BuildKit"
	default PROGRESS_AUTO

config PROGRESS_AUTO
	bool "auto : repliee (tty)"
config PROGRESS_PLAIN
	bool "plain : tout le journal des etapes"

endchoice

config PROGRESS
	string
	default "plain" if PROGRESS_PLAIN
	default "auto"

config UBUNTU_MIRROR
	string "Miroir Ubuntu (vide = le plus rapide, mesure)"

endmenu
```

## kconfig/Kconfig.c54x
```kconfig
# kconfig/Kconfig.c54x - cible c54x_exe (make c54x_exe)

config HAVE_LIBOSMOCODING
	def_bool $(success,pkg-config --exists libosmocoding libosmocore)

comment "*** libosmocoding absent : apt install libosmocore-dev ***"
	depends on !HAVE_LIBOSMOCODING

config C54X_ROM
	bool "Recuperer les ROM DSP 3606 (FreeCalypso, SHA-256)"
	default y
	help
	  make c54x_exe-rom : tools/freecalypso-fetch.sh puis
	  rom/fetch-rom.sh, decoupee dans le repertoire des ROM (Chemins).

config C54X_NATIVE
	bool "-march=native (plus rapide, binaire NON portable)"
	help
	  Le binaire peut faire SIGILL sur un autre processeur.

comment "--- Outils en plus ---"

config C54X_TOOL_ISA_TEST
	bool "isa_test"

config C54X_TOOL_DSP_TESTER
	bool "dsp_tester"

config C54X_TOOL_LAYER1_TESTER
	bool "layer1_tester"
```

## kconfig/Kconfig.debs
```kconfig
# kconfig/Kconfig.debs - cible debs (make debs / release)

config HAVE_GH
	def_bool $(success,command -v gh)

config HAVE_DPKG_SCANPACKAGES
	def_bool $(success,command -v dpkg-scanpackages)

comment "--- Paquets du banc (packaging/build-debs.sh) ---"

config DEBS_PKG_OSMO_OPERATOR
	bool "osmo-operator"
	default y

config DEBS_PKG_PONT
	bool "pont"
	default y

config DEBS_PKG_QEMU_CALYPSO
	bool "qemu-calypso"
	default y

config DEBS_PKG_CALYPSO_FIRMWARE
	bool "calypso-firmware"
	default y


config DEBS_IMAGE
	bool "+ les .deb de la pile (osmo-build-*, bake debs, long)"

comment "*** Publication : gh (GitHub CLI) absent ***"
	depends on !HAVE_GH

comment "*** Publication : dpkg-scanpackages absent (apt install dpkg-dev) ***"
	depends on !HAVE_DPKG_SCANPACKAGES

config DEBS_RELEASE
	bool "Publier en release GitHub (depot apt)"
	depends on HAVE_GH && HAVE_DPKG_SCANPACKAGES
	help
	  make release : les .deb du banc et ceux des groupes facultatifs
	  (cache .deb de l'hote), index apt plat, SHA256SUMS ; refuse tout
	  paquet contenant la ROM DSP TI.
```

## kconfig/Kconfig.docker
```kconfig
# kconfig/Kconfig.docker - cible docker (build.sh)

comment "--- Images Docker (build.sh) ---"
	depends on TARGET_DOCKER

if TARGET_DOCKER

config DOCKER_RUN_ONLY
	bool "Seulement osmocom-run (--build-run, sur l'image locale)"
	help
	  Ne reconstruit que l'image osmocom-run, au-dessus de l'image
	  osmocom-nitb deja presente localement. Les autres options de ce
	  menu (--fast, --lite, --stp, groupes) ne s'appliquent pas.

config DOCKER_FAST
	bool "Build rapide (--fast)"
	depends on !DOCKER_RUN_ONLY
	depends on ARCH_AMD64
	help
	  osmocom-nitb sans compiler ce qui existe en .deb dans la release
	  osmo-operator (SHA-256 verifies). Les .deb de la release sont amd64 :
	  l'option n'existe pas en arm64.

comment "--- .deb de la release (--fast) ---"
	depends on DOCKER_FAST

if DOCKER_FAST

comment "Coches : pris dans la release. Decoches : compiles dans l'image."

config FAST_DEB_QOSMO
	bool "qosmo : QEMU Calypso"
	default y

config FAST_DEB_GRGSM_EXE
	bool "grgsm-exe : grgsm_exe"
	default y
	depends on FEAT_GRGSM_EXE
	help
	  N'a de sens qu'avec le composant grgsm_exe de l'image.

config FAST_DEB_GRGSM_VENV
	bool "grgsm-venv : GNU Radio + gr-gsm (/root/.env)"
	default y
	depends on FEAT_GNURADIO
	help
	  N'a de sens que si GNU Radio est construit (selectionne par
	  grgsm_exe).

config FAST_DEB_CALYPSO_FIRMWARE
	bool "calypso-firmware : firmwares Calypso (osmocom-bb)"
	default y

config FAST_DEB_C54X_EXE_NOROM
	bool "c54x-exe-norom : c54x_exe sans ROM (ROM prise a FreeCalypso)"
	default y

endif

config DOCKER_LITE
	bool "Image osmocom-nitb:lite en plus (sans les sources)"
	depends on !DOCKER_RUN_ONLY

config DOCKER_STP
	bool "Image osmocom-stp en plus (hub SS7, en parallele)"
	depends on !DOCKER_RUN_ONLY

endif

# Groups of the image: used by build.sh (--without) and by build-iso.sh.
config USES_GROUPS
	def_bool (TARGET_DOCKER && !DOCKER_RUN_ONLY) || TARGET_ISO

comment "--- Composants de l'image docker (tools/features.conf) ---"
	depends on USES_GROUPS

if USES_GROUPS

source "kconfig/generated/Kconfig.groups"

endif
```

## kconfig/Kconfig.native
```kconfig
# kconfig/Kconfig.native - cible native : install.sh, c54x_exe, .deb

comment "--- Natif : ce qui est fait sur cet hote ---"
	depends on TARGET_NATIVE

if TARGET_NATIVE

config NATIVE_INSTALL
	bool "Installation native (install.sh, install_modules/)"
	default y
	help
	  L'installation modulaire sur l'hote : paquets (extraits du
	  Dockerfile), sources, correctifs, compilation, configs, bureau.
	  Chaque etape est un module ; une etape decochee est passee a
	  install.sh --skip, et ce qui en depend disparait du menu.

if NATIVE_INSTALL

config NATIVE_REINSTALL
	bool "Tout rejouer, meme ce qui est deja installe (--reinstall)"

source "kconfig/generated/Kconfig.native"

endif

config NATIVE_C54X
	bool "c54x_exe : le DSP Calypso hors QEMU (make c54x_exe)"
	help
	  Compile c54x_exe sur l'hote (clone s'il manque). Il faut gcc,
	  pkg-config et libosmocore-dev (libosmocoding) ; voir
	  doc/c54x_exe-depuis-ubuntu-vierge.md.

if NATIVE_C54X
source "kconfig/Kconfig.c54x"
endif

config NATIVE_DEBS
	bool ".deb du banc (make debs)"
	help
	  Les paquets du banc (packaging/build-debs.sh) et, en option, ceux
	  de la pile (osmo-build-*) et leur publication en release GitHub,
	  qui sert aussi de depot apt aux ISO.

if NATIVE_DEBS
source "kconfig/Kconfig.debs"
endif

endif

# Used by Kconfig.debs outside this menu.
config DEBS_RELEASE_TAG
	string "Tag de la release GitHub (depot apt)"
	default "debs-banc"
	depends on DEBS_RELEASE || ISO_MOD_APT_RELEASE
	help
	  Tag roulant : la release est aussi le depot apt des ISO
	  (iso_modules/89-apt-release.sh).
```

## kconfig/Kconfig.paths
```kconfig
# kconfig/Kconfig.paths - chemins (relatifs : depuis la racine du depot)

menu "Chemins"

comment "Relatif = depuis la racine du depot"

config DEB_CACHE
	string "Cache .deb de l'hote (OSMO_DEB_CACHE)"
	default "/var/cache/osmo-debs"
	depends on BUILDS_IMAGE || NATIVE_DEBS

config FREECALYPSO_CACHE
	string "Cache FreeCalypso (FREECALYPSO_CACHE)"
	default ".cache/freecalypso"

config ISO_WORK
	string "Travail de build-iso.sh (OSMO_ISO_WORK ; pas un tmpfs)"
	default "/var/tmp"
	depends on TARGET_ISO

config OUTPUT_DIR
	string "Sortie des ISO"
	default "."
	depends on TARGET_ISO

config C54X_DIR
	string "Sources de c54x_exe (clone s'il est absent)"
	default "../c54x_exe"
	depends on NATIVE_C54X

config QOSMO_DIR
	string "Sources de qosmo (clone s'il est absent)"
	default "../qosmo"
	depends on NATIVE_C54X || NATIVE_DEBS

config FIRMWARE_DIR
	string "Firmwares Calypso (osmocom-bb/firmware)"
	default "../firmware"
	depends on NATIVE_DEBS

config ROM_DIR
	string "ROM DSP decoupees (--rom-dir de c54x_exe)"
	default ".."
	depends on NATIVE_C54X

config DEBS_OUT
	string ".deb produits (make debs)"
	default "packaging/dist"
	depends on NATIVE_DEBS

endmenu
```
